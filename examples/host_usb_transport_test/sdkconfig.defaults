## examples/host_usb_transport_test/sdkconfig.defaults
```kconfig
# ESP-Hosted configuration
CONFIG_ESP_HOSTED_ENABLED=y

# USB Transport configuration
CONFIG_ESP_HOSTED_USB_HOST_INTERFACE=y
CONFIG_ESP_HOSTED_USB_HOST_MODE=y
CONFIG_ESP_HOSTED_USB_TX_Q_SIZE=20
CONFIG_ESP_HOSTED_USB_RX_Q_SIZE=20
CONFIG_ESP_HOSTED_USB_CHECKSUM=y
CONFIG_ESP_HOSTED_USB_BULK_ENDPOINT_SIZE=512
CONFIG_ESP_HOSTED_USB_CDC_ACM_CLASS=y

# Console configuration
CONFIG_ESP_CONSOLE_UART_DEFAULT=y
CONFIG_ESP_CONSOLE_UART_NUM=0
CONFIG_ESP_CONSOLE_UART_BAUDRATE=115200

# WiFi configuration 
CONFIG_ESP_WIFI_AUTH_OPEN=y
CONFIG_ESP_WIFI_AUTH_WEP=y
CONFIG_ESP_WIFI_AUTH_WPA_PSK=y
CONFIG_ESP_WIFI_AUTH_WPA2_PSK=y
CONFIG_ESP_WIFI_AUTH_WPA_WPA2_PSK=y
CONFIG_ESP_WIFI_AUTH_WPA3_PSK=y
CONFIG_ESP_WIFI_AUTH_WPA2_WPA3_PSK=y

# USB Host configuration
CONFIG_USB_HOST_ENABLE=y
CONFIG_USB_HOST_HW_BUFFER_BIAS_BALANCED=y

# TinyUSB configuration (for device mode, if needed)
CONFIG_TINYUSB_ENABLED=y
CONFIG_TINYUSB_CDC_ENABLED=y
CONFIG_TINYUSB_CDC_COUNT=1

# Log levels
CONFIG_LOG_DEFAULT_LEVEL_INFO=y
CONFIG_ESP_HOSTED_LOG_LEVEL_INFO=y

# Memory optimization
CONFIG_ESP_MAIN_TASK_STACK_SIZE=8192
CONFIG_ESP_SYSTEM_EVENT_TASK_STACK_SIZE=4096
```
